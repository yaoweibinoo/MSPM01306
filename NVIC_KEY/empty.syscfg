/**
 * @cliArgs --device "MSPM0L130X" --package "VQFN-32(RHB)" --part "Default" --product "mspm0_sdk@1.00.00.04"
 * @versions {"tool":"1.15.0+2826"}
 */

/**
 * Import the modules used in this configuration.
 */
const GPIO   = scripting.addModule("/ti/driverlib/GPIO", {}, false);
const GPIO1  = GPIO.addInstance();
const GPIO2  = GPIO.addInstance();
const SYSCTL = scripting.addModule("/ti/driverlib/SYSCTL");

/**
 * Write custom configuration values to the imported modules.
 */
GPIO1.$name                         = "LED";
GPIO1.port                          = "PORTA";
GPIO1.associatedPins[0].$name       = "USER_LED";
GPIO1.associatedPins[0].assignedPin = "0";

const Board = scripting.addModule("/ti/driverlib/Board", {}, false);

GPIO2.$name                         = "SWITCHS";
GPIO2.port                          = "PORTA";
GPIO2.associatedPins[0].$name       = "USER_SWITCH";
GPIO2.associatedPins[0].direction   = "INPUT";
GPIO2.associatedPins[0].assignedPin = "14";


/**
 * Pinmux solution for unlocked pins/peripherals. This ensures that minor changes to the automatic solver in a future
 * version of the tool will not impact the pinmux you originally saw.  These lines can be completely deleted in order to
 * re-solve from scratch.
 */
GPIO1.associatedPins[0].pin.$suggestSolution = "ball.1";
Board.peripheral.$suggestSolution            = "DEBUGSS";
Board.peripheral.swclkPin.$suggestSolution   = "ball.24";
Board.peripheral.swdioPin.$suggestSolution   = "ball.23";
GPIO2.associatedPins[0].pin.$suggestSolution = "ball.18";
SYSCTL.peripheral.$suggestSolution           = "SYSCTL";
